## buildroot-external/configs/mineos_defconfig
```kconfig
# Arquitetura Alvo: x86_64
BR2_x86_64=y

# Toolchain Externa pré-compilada Bootlin (Glibc x86_64) - economiza gigabytes e compila em minutos
BR2_TOOLCHAIN_EXTERNAL=y
BR2_TOOLCHAIN_EXTERNAL_BOOTLIN=y
BR2_TOOLCHAIN_EXTERNAL_BOOTLIN_X86_64_GLIBC_STABLE=y

# Kernel Linux 6.6 LTS com fragmento DRM/KMS
BR2_LINUX_KERNEL=y
BR2_LINUX_KERNEL_CUSTOM_VERSION=y
BR2_LINUX_KERNEL_CUSTOM_VERSION_VALUE="6.6.158"
BR2_LINUX_KERNEL_USE_DEFCONFIG=y
BR2_LINUX_KERNEL_DEFCONFIG="x86_64"
BR2_LINUX_KERNEL_CONFIG_FRAGMENT_FILES="$(BR2_EXTERNAL_MINEOS_PATH)/board/mineos/linux.fragment"

# Identidade do Sistema
BR2_TARGET_GENERIC_HOSTNAME="mineos"
BR2_TARGET_GENERIC_ISSUE="Bem-vindo ao MineOS \n \l"
BR2_ROOTFS_OVERLAY="$(BR2_EXTERNAL_MINEOS_PATH)/board/mineos/rootfs-overlay"
BR2_ROOTFS_POST_BUILD_SCRIPT="$(BR2_EXTERNAL_MINEOS_PATH)/board/mineos/post-build.sh"
BR2_GLOBAL_PATCH_DIR="$(BR2_EXTERNAL_MINEOS_PATH)/patches"

# Gestão de Dispositivos e Udev
BR2_ROOTFS_DEVICE_CREATION_DYNAMIC_EUDEV=y
BR2_PACKAGE_EUDEV=y

# Pilha Gráfica Mesa3D (OpenGL, EGL, GBM)
BR2_PACKAGE_MESA3D=y
BR2_PACKAGE_MESA3D_GALLIUM_DRIVER_VIRGL=y
BR2_PACKAGE_MESA3D_GALLIUM_DRIVER_IRIS=y
BR2_PACKAGE_MESA3D_GALLIUM_DRIVER_RADEONSI=y
BR2_PACKAGE_MESA3D_OPENGL_EGL=y
BR2_PACKAGE_MESA3D_OPENGL_ES=y
BR2_PACKAGE_MESA3D_GBM=y
BR2_PACKAGE_MESA3D_PLATFORM_DRM=y
BR2_PACKAGE_MESA3D_PLATFORM_WAYLAND=y
BR2_PACKAGE_MESA3D_PLATFORM_SURFACELESS=y
BR2_PACKAGE_MESA3D_GALLIUM_DRIVER_SWRAST=y

# Pilha Wayland e Compositor Kiosk Cage
BR2_PACKAGE_WAYLAND=y
BR2_PACKAGE_WAYLAND_PROTOCOLS=y
BR2_PACKAGE_WLROOTS=y
BR2_PACKAGE_PIXMAN=y
BR2_PACKAGE_CAGE=y
BR2_PACKAGE_LIBINPUT=y
BR2_PACKAGE_LIBXKBCOMMON=y
BR2_PACKAGE_XKEYBOARD_CONFIG=y
BR2_PACKAGE_SEATD=y
BR2_PACKAGE_SEATD_DAEMON=y

# Áudio e Utilitários
BR2_PACKAGE_PIPEWIRE=y
BR2_PACKAGE_ALSA_LIB=y
BR2_PACKAGE_UTIL_LINUX=y

# Formatos de Imagem de Saída (ext4 e cpio/initrd para QEMU)
BR2_TARGET_ROOTFS_EXT2=y
BR2_TARGET_ROOTFS_EXT2_4=y
BR2_TARGET_ROOTFS_EXT2_SIZE="512M"
BR2_TARGET_ROOTFS_CPIO=y
BR2_TARGET_ROOTFS_CPIO_GZ=y
```
